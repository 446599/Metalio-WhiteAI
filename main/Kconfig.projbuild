## main/Kconfig.projbuild
```kconfig
menu "Metalio Hardware Test"

choice BOARD_TYPE
    prompt "Board Type"
    default BOARD_TYPE_METALIO_E_INK_4
    help
        Board type. 开发板类型
    config BOARD_TYPE_METALIO_E_INK_4
        bool "Metalio E-Ink 4"
        depends on IDF_TARGET_ESP32S3
endchoice

endmenu

menu "WhiteAI product features"
    config WHITEAI_EXPERIMENTAL_BLE_DISCOVERY
        bool "Experimental BLE discovery (not audio-safe product firmware)"
        depends on BT_NIMBLE_ENABLED
        default n
        help
            Link the ESP32 BLE controller and enable discovery in quick controls.
            This consumed about 20 KiB additional shared internal RAM on the
            affected S3 build, even before the first scan, preventing allocation
            of the 24 KiB audio playback stack. Keep disabled for the product.
            This is independent of the external UART/I2S Bluetooth audio module.
            Enabling requires a separately measured memory/stack budget and
            on-device TTS, alarm and BLE coexistence validation.
endmenu
```
